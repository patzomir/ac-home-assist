## firmware/zigbee-hub/sdkconfig.defaults
```kconfig
# ESP32-C6 Zero — Zigbee Hub
# Target
CONFIG_IDF_TARGET="esp32c6"

# Flash size (ESP32-C6 Zero has 4 MB)
CONFIG_ESPTOOLPY_FLASHSIZE_4MB=y
CONFIG_ESPTOOLPY_FLASHSIZE="4MB"

# Partition table
CONFIG_PARTITION_TABLE_CUSTOM=y
CONFIG_PARTITION_TABLE_CUSTOM_FILENAME="partitions.csv"

# Zigbee — coordinator role
CONFIG_ZB_ENABLED=y
CONFIG_ZB_ZCL_SUPPORT_CLUSTER_BASIC=y
CONFIG_ZB_ZCL_SUPPORT_CLUSTER_IDENTIFY=y
CONFIG_ZB_ZCL_SUPPORT_CLUSTER_THERMOSTAT=y
CONFIG_ZB_ZCL_SUPPORT_CLUSTER_ON_OFF=y
CONFIG_ZB_ZCL_SUPPORT_CLUSTER_TIME=y

# Zigbee network settings
CONFIG_ZB_NETWORK_CHANNEL=11
CONFIG_ZB_COORDINATOR_ALL_MAC_RX_ON_WHEN_IDLE=y

# WiFi/Zigbee coexistence — ESP32-C6 shares one radio between WiFi and 802.15.4.
# Without these settings the Zigbee receiver is starved during WiFi activity,
# causing beacon requests from joining devices to be missed entirely.
CONFIG_ESP_COEX_SW_COEXIST_ENABLE=y
CONFIG_ESP_WIFI_STA_DISCONNECTED_PM_ENABLE=y
# Disable WiFi power save so the coex arbiter doesn't have to wake the radio
# for WiFi beacons — gives 802.15.4 more predictable airtime.
CONFIG_ESP_WIFI_SLP_IRAM_OPT=n
CONFIG_ESP_WIFI_SLP_DEFAULT_MIN_ACTIVE_TIME=0
CONFIG_ESP_WIFI_SLP_DEFAULT_MAX_ACTIVE_TIME=0

# HTTPD / HTTP client
CONFIG_ESP_HTTP_CLIENT_ENABLE_HTTPS=y

# FreeRTOS tick rate
CONFIG_FREERTOS_HZ=1000

# NVS for storing paired devices and schedule
CONFIG_NVS_ENCRYPTION=n

# SNTP for time sync
CONFIG_LWIP_SNTP_MAX_SERVERS=2

# UART console — disabled in production; use JTAG debugger or OTA logs instead
CONFIG_ESP_CONSOLE_NONE=y

# Compiler optimisation — size-optimised release build
CONFIG_COMPILER_OPTIMIZATION_SIZE=y

# Logging — WARN in production to avoid leaking network/device info over UART
# Change to CONFIG_LOG_DEFAULT_LEVEL_DEBUG=y locally when needed
CONFIG_LOG_DEFAULT_LEVEL_WARN=y
CONFIG_LOG_MAXIMUM_LEVEL_WARN=y

# Stack sizes
CONFIG_ESP_MAIN_TASK_STACK_SIZE=8192

# CONFIG_ZB_DEBUG_MODE is not set
```
